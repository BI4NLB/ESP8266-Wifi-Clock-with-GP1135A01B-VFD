// ESP8266 ESP-01 Internet real time clock
 
#include <ESP8266WiFi.h>
#include <WiFiUdp.h>
 
#include <NTPClient.h>               // Include NTPClient library
#include <TimeLib.h>                 // Include Arduino time library

const char *ssid     = "godlike";
const char *password = "126shanliuyuanzhang";

unsigned char Disp_Buf[960] = {
0x00,0x00,0x00,0x00,0x00,0x00,0x00,0x00,0x00,0x00,0x00,0x00,0x00,0x00,0x00,0x00,
 0x00,0x00,0x00,0xF0,0x00,0x07,0xFE,0x00,0x1F,0xFF,0x80,0x3F,0x9F,0xC0,0x3E,0x07,
 0xC0,0x7C,0x03,0xE0,0x78,0x01,0xE0,0xF8,0x01,0xF0,0xF8,0x01,0xF0,0xF0,0x00,0xF0,
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 0x00,0x00,0x00,0x00,0x00,0x00,0x00,0x00/*"7",7*/
};

unsigned char Num[10][120] = {
{0x00,0x00,0x00,0x00,0x00,0x00,0x00,0x00,0x00,0x00,0x00,0x00,0x00,0x00,0x00,0x00,
 0x00,0x00,0x00,0xF0,0x00,0x07,0xFE,0x00,0x1F,0xFF,0x80,0x3F,0x9F,0xC0,0x3E,0x07,
 0xC0,0x7C,0x03,0xE0,0x78,0x01,0xE0,0xF8,0x01,0xF0,0xF8,0x01,0xF0,0xF0,0x00,0xF0,
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 0x00,0x00,0x00,0x00,0x00,0x00,0x00,0x00}/*"9",9*/
};

WiFiUDP ntpUDP;
 
// 'time.nist.gov' is used (default server) with +1 hour offset (3600 seconds) 60 seconds (60000 milliseconds) update interval
NTPClient timeClient(ntpUDP, "time1.aliyun.com", 28800, 60000);
 
char Time[] = "TIME:00:00:00";
char Date[] = "DATE:00/00/2000";
byte last_second, second_, minute_, hour_, day_, month_;
unsigned char second_low,second_high, minute_low, minute_high, hour_low, hour_high;
int year_;

void Disp_Null()  
{   
    int i=0;
    
    Serial.write(0x1B);
    Serial.write(0x5C);
    Serial.write(0x3F);
    Serial.write(0x4C);
    Serial.write(0x47);
    
    Serial.write(0x30);  //set position x

    Serial.write(0x3B);
    
    Serial.write(0x30);  //set position y
    
    Serial.write(0x3B);
    
    Serial.write(0x34);  // hight = 40
    Serial.write(0x30);
    
    Serial.write(0x3B);
    
    Serial.write(0x31);  // width = 160
    Serial.write(0x36);
    Serial.write(0x30);
    
    Serial.write(0x3B);

    for(i=0;i<800;i++)
    {
      Serial.write(0xFF);
    }

}

void DispNum0(int x,int y,unsigned char Digit) 
{   
    int i=0;
    
    Serial.write(0x1B);
    Serial.write(0x5C);
    Serial.write(0x3F);
    Serial.write(0x4C);
    Serial.write(0x47);


    Serial.write(0x30);  //set position x

    Serial.write(0x3B);
    
    Serial.write(0x30);  //set position y
    
    Serial.write(0x3B);
    
    Serial.write(0x34);  // hight = 40
    Serial.write(0x30);
    
    Serial.write(0x3B);
    
    Serial.write(0x32);  // width = 20
    Serial.write(0x30);
    
    Serial.write(0x3B);

    for(i=0;i<120;i++)
    {
      Serial.write(Num[Digit][i]);
    }

}


void DispNum(int x,int y,unsigned char Digit) 
{   
    int i=0;
    unsigned char x_high,x_mid, x_low,y_high,y_mid,y_low;
    
    x_high = x / 100 + 48;
    x_mid  = x % 100 /10 + 48;
    x_low  = x % 10 + 48;     // x postion value
    
    y_high = y / 100 + 48;
    y_mid  = y % 100 /10 + 48;
    y_low  = y % 10 + 48;     // y postion value
    
    Serial.write(0x1B);
    Serial.write(0x5C);
    Serial.write(0x3F);
    Serial.write(0x4C);
    Serial.write(0x47);

    Serial.write(x_high);
    Serial.write(x_mid);
    Serial.write(x_low);  //set position x

    Serial.write(0x3B);
    
    Serial.write(y_high);
    Serial.write(y_mid);
    Serial.write(y_low);  //set position y
    
    Serial.write(0x3B);
    
    Serial.write(0x34);  // hight = 40
    Serial.write(0x30);
    
    Serial.write(0x3B);
    
    Serial.write(0x32);  // width = 20
    Serial.write(0x30);
    
    Serial.write(0x3B);

    for(i=0;i<120;i++)
    {
      Serial.write(Num[Digit][i]);
    }
}
 
void setup() 
{
 
  Serial.begin(19200);

  WiFi.begin(ssid, password);
 
  //Serial.print("Connecting.");
  while ( WiFi.status() != WL_CONNECTED ) {
    delay(500);
    //Serial.print(".");
  }
  //Serial.println("connected");
 
  timeClient.begin();

}

//void loop() 
//{
//  int i,j;
//
//    Serial.write(0x1B);
//    Serial.write(0x5C);
//    Serial.write(0x3F);
//    Serial.write(0x4C);
//    Serial.write(0x47);
//    
//    Serial.write(0x30);  //set position x=0
//
//    Serial.write(0x3B);
//    
//    Serial.write(0x30);  //set position y=0
//    
//    Serial.write(0x3B);
//    
//    Serial.write(0x34);  // hight = 40
//    Serial.write(0x30);
//    
//    Serial.write(0x3B);
//    
//    Serial.write(0x31);  // width=160
//    Serial.write(0x36);
//    Serial.write(0x30);
//    
//    Serial.write(0x3B);
//    
//      for(i=0;i<800;i++)
//      {
//          Serial.write(0xFF);
//      }
//
//    
//    Serial.write(0x1B);
//    Serial.write(0x5C);
//    Serial.write(0x3F);
//    Serial.write(0x4C);
//    Serial.write(0x47);
//    
//    Serial.write(0x30);  //set position x=0
//
//    Serial.write(0x3B);
//    
//    Serial.write(0x30);  //set position y=0
//    
//    Serial.write(0x3B);
//    
//    Serial.write(0x34);  // hight = 40
//    Serial.write(0x30);
//    
//    Serial.write(0x3B);
//    
//    Serial.write(0x31);  // width=160
//    Serial.write(0x36);
//    Serial.write(0x30);
//    
//    Serial.write(0x3B);
//    
//      for(i=0;i<800;i++)
//      {
//          Serial.write(0xF0);
//      }  
//      //delay(400);
//      //Serial.write(0x0C);
//   
//}



void loop() 
{
  timeClient.update();
  unsigned long unix_epoch = timeClient.getEpochTime();    // Get Unix epoch time from the NTP server
 
  second_ = second(unix_epoch);
  if (last_second != second_) 
  {
    minute_ = minute(unix_epoch);
    hour_   = hour(unix_epoch);
    day_    = day(unix_epoch);
    month_  = month(unix_epoch);
    year_   = year(unix_epoch);
 
    second_low = second_ % 10;
    second_high = second_ / 10;
    minute_low  = minute_ % 10;
    minute_high  = minute_ / 10;
    hour_low  = hour_   % 10;
    hour_high  = hour_   / 10;
  
    // Send time and date to serial monitor
    DispNum(0,0,hour_high);
    DispNum(20,0,hour_low);
    //DispNum(40,0,5);
    DispNum(60,0,minute_high);
    DispNum(80,0,minute_low);
    //DispNum(100,0,5);
    DispNum(120,0,second_high);
    DispNum(140,0,second_low);
    delay(400);

    Serial.write(0x0C);
    
    //Disp_Null();
    last_second = second_;
  }
  delay(200);
 
}



